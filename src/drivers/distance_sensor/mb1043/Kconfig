## src/drivers/distance_sensor/mb1043/Kconfig
```kconfig
menuconfig DRIVERS_DISTANCE_SENSOR_MB1043
	bool "mb1043 ultrasound sensor"
	default n
	---help---
		Enable support for mb1043 ultrasound sensor
```
